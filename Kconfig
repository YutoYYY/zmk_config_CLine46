## dts/bindings/behaviors/cline46,behavior-app-tab.yaml
```yaml
description: Tab key that switches apps with the thumb key next to Space (Ctrl+Tab -> Alt+Tab on Windows, Alt+Tab -> Cmd+Tab on Mac)

compatible: "cline46,behavior-app-tab"

include: zero_param.yaml
```

## dts/bindings/behaviors/cline46,behavior-mac-tab.yaml
```yaml
description: Tab key that turns a held Alt+Tab into Cmd+Tab (for Mac mode)

compatible: "cline46,behavior-mac-tab"

include: zero_param.yaml
```

## dts/bindings/behaviors/cline46,behavior-os-mode.yaml
```yaml
description: Windows/Mac mode switch. Activates or deactivates the Mac layer and remembers it across reboots.

compatible: "cline46,behavior-os-mode"

include: zero_param.yaml

properties:
  layer:
    type: int
    required: true
    description: Layer id of the Mac mode layer
  mac-mode:
    type: boolean
    description: If set, this binding switches to Mac mode; otherwise to Windows mode
```

## modules/typing-heatmap/Kconfig
```kconfig
config ZMK_FEATURE_TYPING_HEATMAP
    bool "Enable typing statistics"
    select ZMK_LOW_PRIORITY_WORK_QUEUE if !ZMK_SPLIT || ZMK_SPLIT_ROLE_CENTRAL

if ZMK_FEATURE_TYPING_HEATMAP

config ZMK_FEATURE_TYPING_HEATMAP_STUDIO_RPC
    bool "Enable typing statistics custom Studio RPC"
    depends on ZMK_STUDIO

config ZMK_FEATURE_TYPING_HEATMAP_SAVE_INTERVAL_SECONDS
    int "Minimum seconds between automatic statistics saves"
    range 60 86400
    default 1800

config ZMK_FEATURE_TYPING_HEATMAP_MIN_PRESSES
    int "Minimum unsaved presses before an automatic save"
    range 1 1000000
    default 100

endif
```
